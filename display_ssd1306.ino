#define BLACK   0x0000
#define BLUE    0x001F
#define RED     0xF800
#define GREEN   0x07E0
#define CYAN    0x07FF
#define MAGENTA 0xF81F
#define YELLOW  0xFFE0
// #define WHITE   0xFFFF
#define GREY     0xD6BA


/*
void setup_display() {
//  if(!display.begin(SSD1306_SWITCHCAPVCC, 0x3C)) { // Address 0x3D for 128x64
//    Serial.println(F("SSD1306 allocation failed"));
//    for(;;);
//  }
  display.begin(SSD1306_SWITCHCAPVCC, 0x3C);
//  display.begin(SH1106_SWITCHCAPVCC, 0x78);
//  delay(1000);
  display.clearDisplay();
  display.display(); 
  showBitmap();
//  display.clearDisplay();
//  display_status();
}
*/

void setup_oled() {
  display.begin(SSD1306_SWITCHCAPVCC, 0x3C);
  display.clearDisplay();
  display.display(); 
};

#define bitmap_height   128
#define bitmap_width    64
static const unsigned char PROGMEM bitmap[] =
{ 0x00, 0x00, 0x00, 0x00, 0x00, 0x00, 0x00, 0x00, 0x00, 0x00, 0x00, 0x00, 0x00, 0x00, 0x00, 0x00,
0x00, 0x00, 0x00, 0x00, 0x00, 0x00, 0x00, 0x00, 0x00, 0x00, 0x00, 0x00, 0x00, 0x00, 0x00, 0x00,
0x00, 0x00, 0x00, 0x00, 0x00, 0x00, 0x00, 0x00, 0x00, 0x00, 0x00, 0x00, 0x00, 0x00, 0x00, 0x00,
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0x00, 0x00, 0x00, 0x00, 0x00, 0x00, 0x00, 0x00, 0x00, 0x00, 0x00, 0x00, 0x00, 0x00, 0x00, 0x00
};

static const unsigned char PROGMEM tft_splash[] = {
0x00, 0x00, 0x00, 0x00, 0x00, 0x00, 0x00, 0x00, 0x00, 0x00, 0x00, 0x00, 0x00, 0x00, 0x00, 0x00,
0x00, 0x00, 0x00, 0x00, 0x00, 0x00, 0x00, 0x00, 0x00, 0x00, 0x00, 0x00, 0x00, 0x00, 0x00, 0x00,
0x00, 0x00, 0x00, 0x00, 0x00, 0x00, 0x00, 0x00, 0x00, 0x00, 0x00, 0x00, 0x00, 0x00, 0x00, 0x00,
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0x00, 0x00, 0x00, 0x00, 0x00, 0x00, 0x00, 0x00, 0x00, 0x00, 0x00, 0x00, 0x00, 0x00, 0x00, 0x00
};




void showBitmap(void) {
  if (oled_connected) { display.clearDisplay();
    display.drawBitmap(0, 0, bitmap, bitmap_height, bitmap_width, WHITE);
    display.display();
  }; 
  
  if (tft_connected) {tft.drawRGBBitmap (0,0,splash_tft,240,240);
    delay(3000);
    tft.fillScreen(ST77XX_BLACK);
  };
}

void showEthconnected() {
  if (oled_connected) {display.drawBitmap(0, 0, bitmapEthOn, 16, 16, WHITE);};
  if (tft_connected) {tft.drawBitmap(25, 5, bitmapEthOn, 16, 16, GREEN);};
}

void showEthNot() {
  if (tft_connected) {tft.drawBitmap(25, 5, bitmapEthOn, 16, 16, RED);};
}

void showWificonnected() {
  if (oled_connected) {display.drawBitmap(0, 0, bitmapWifiOn, 16, 16, WHITE);};
  if (tft_connected) {tft.drawBitmap(5, 5, bitmapWifiOn, 16, 16, GREEN);};
}

void showMQTTconnected() {
  if (oled_connected) {display.drawBitmap(112, 0, bitmapMQTTOn, 16, 16, WHITE);};
  if (tft_connected) {tft.drawBitmap(220, 5, bitmapMQTTOn, 16, 16, GREEN);};
}

void showEthoff() {
  if (oled_connected) {display.drawBitmap(0, 0, bitmapEthOff, 16, 16, WHITE);};
  if (tft_connected) {tft.drawBitmap(25, 5, bitmapEthOff, 16, 16, RED);};
}

void showMQTToff() {
  if (oled_connected) {display.drawBitmap(112, 0, bitmapMQTTOff, 16, 16, WHITE);};
  if (tft_connected) {tft.drawBitmap(220, 5, bitmapMQTTOff, 16, 16, RED);};
}

void display_status_tft () {
  // tft.setRotation(1);

  tft.setCursor(70, 5);
  tft.setTextColor(ST77XX_CYAN);
  tft.setTextSize(2);
  tft.print(" LH ");
  tft.println(CURR_VERS);
  tft.setCursor(0, 40);

  tft.setTextColor(ST77XX_WHITE,BLACK);
  tft.setTextSize(2);
  if (XDLINE1 != DLINE1) {tft.println(DLINE1);XDLINE1 = DLINE1;};
  tft.setTextSize(2);
  tft.setTextColor(ST77XX_GREEN,BLACK);
  tft.setCursor(0, 60);
  if (XDLINE8 != DLINE8) {
   // tft.println("                   ");
    tft.setCursor(0, 60);
    tft.println(DLINE8);XDLINE8 = DLINE8;};
  tft.setCursor(0, 80);
 // if (XDLINE3 != DLINE3) {tft.println(DLINE3);XDLINE3 = DLINE3;};
  tft.setTextColor(GREEN,BLACK);
  tft.setCursor(50, 115);
  if (XDLINE2 != DLINE2) {
    tft.setTextSize(3);
    tft.println("          ");
    tft.setCursor(50, 115);
    tft.println(DLINE2);
    XDLINE2 = DLINE2;
    // tft.setTextSize(2);
  };
  tft.setCursor(0, 140);
  if (XDLINE5 != DLINE5) {tft.println(DLINE5);XDLINE5 = DLINE5;};
  tft.setCursor(0, 160);
  if (XDLINE6 != DLINE6) {tft.println(DLINE6);XDLINE6 = DLINE6;};
  tft.setCursor(0, 180);
  display.setTextColor(YELLOW, BLACK);
  tft.setTextSize(2);
  tft.println(DLINE7);
  DLINE7 = "                ";
  tft.setCursor(0, 200);
 // if (XDLINE8 != DLINE8) {tft.println(DLINE8);XDLINE8 = DLINE8;};
  tft.setCursor(0, 210);
  tft.setTextSize(1);
  
  if (ina_connected) {
    tft.println (" CURRENT DRAW");
    //TEMP");
    tft.setCursor(0, 220);
    tft.setTextSize(2);
    if (XDLINE3 != DLINE3) {tft.println(DLINE3);XDLINE3 = DLINE3;};
  };
  // "Binary", "Door", "Window", "Switch", "Relay", "Light", "Relay3", "iBinary"
  switch (ICONLINE) {
    case '0':
      tft.drawBitmap(0, 100, bitmapBinary, 48, 48, BLUE, BLACK);
    break;
    case '1':
      tft.drawBitmap(0, 100, bitmapDoor, 48, 48, BLUE, BLACK);
    break;
    case '2':
      tft.drawBitmap(0, 100, bitmapWindow, 48, 48, BLUE, BLACK);
    break;
    case '3':
      tft.drawBitmap(0, 100, bitmapSwitch, 48, 48, BLUE, BLACK);
    break;
    case '4':
      tft.drawBitmap(0, 100, bitmapFlash, 48, 48, BLUE, BLACK);
    break;
    case '5':
      tft.drawBitmap(0, 100, bitmapLight, 48, 48, BLUE, BLACK);
    break;
    case '6':
      tft.drawBitmap(0, 100, bitmapTimer, 48, 48, BLUE, BLACK);
    break;
    case '7':
      tft.drawBitmap(0, 100, bitmapBinary, 48, 48, BLUE, BLACK);
    break;
    case '8':
      tft.drawBitmap(0, 100, bitmapHarddisk, 48, 48, BLUE, BLACK);
    break;
  }
 // tft.drawBitmap(10, 100, bitmapFlash, 48, 48, BLUE);
//  tft.setTextSize(2);
//  tft.setCursor(0, 100);
//  tft.println (ICONLINE);
  
// tft.drawBitmap(80, 100, entity_bar, 111, 33, CYAN);
}

void display_status_oled () {
  display.clearDisplay();
  if (eth_connected == true) {showEthconnected();}; 
  if (wifi_connected == true){showWificonnected();};
  if (eth_connected == false && wifi_connected == false){showEthoff();};
  if (MQTT_connected == true) {showMQTTconnected();}; 
  if (MQTT_connected == false) { showMQTToff();};
 
  display.setTextSize(2);
  display.setTextColor(WHITE);
  display.setCursor(12, 0);
  display.print(" LH ");
  display.println(CURR_VERS);
  display.setCursor(0,20);
  display.setTextSize(1);
  display.print (DLINE1);
  display.setTextSize(2);
  display.setCursor(0,32);
  display.print (DLINE2);
  display.setCursor(0,48);
  display.print (DLINE3);
  display.display(); 
}
void display_status () {
  if (eth_connected == true) {showEthconnected();}; 
  if (eth_connected == false) {showEthNot();}; 
  if (wifi_connected == true){showWificonnected();};
  if (eth_connected == false && wifi_connected == false){showEthoff();};
  if (MQTT_connected == true) {showMQTTconnected();}; 
  if (MQTT_connected == false) { showMQTToff();};
  if (oled_connected) {display_status_oled ();};  
  if (tft_connected) {display_status_tft ();};
}
